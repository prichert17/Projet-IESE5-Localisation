## UWB-test-examples/build_1/UWB-test-examples/Kconfig/Kconfig.shield
```kconfig
osource "C:/ncs/v3.2.1/nrf/boards/shields/*/Kconfig.shield"
osource "C:/Projet-IESE5-Localisation/UWB-test-examples/dw3000-decadriver/platform/zephyr/boards/shields/*/Kconfig.shield"
```

## UWB-test/build/Kconfig/boards/Kconfig.nrf52833dk
```kconfig
# Load board Kconfig descriptions.
osource "C:/ncs/v3.2.1/zephyr/boards/nordic/nrf52833dk/Kconfig.nrf52833dk"
```

## UWB-test/build/UWB-test/Kconfig/Kconfig.shield
```kconfig
osource "C:/ncs/v3.2.1/nrf/boards/shields/*/Kconfig.shield"
osource "C:/Projet-IESE5-Localisation/UWB-test/lib/dw3000-decadriver-source-master/platform/zephyr/boards/shields/*/Kconfig.shield"
```

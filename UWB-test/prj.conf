## CMakeLists.txt
```
cmake_minimum_required(VERSION 3.20.0)

# 1. On pointe vers le dossier 'platform' car il contient le dossier 'zephyr'
list(APPEND ZEPHYR_EXTRA_MODULES ${CMAKE_CURRENT_SOURCE_DIR}/lib/dw3000-decadriver-source-master/platform)

# 2. Ensuite on charge Zephyr
find_package(Zephyr REQUIRED HINTS $ENV{ZEPHYR_BASE})

project(UWB-test)

target_sources(app PRIVATE src/main.c)
```

## prj.conf
```kconfig
CONFIG_DW3000=y
CONFIG_DW3000_CHIP_DW3000=y
CONFIG_SPI=y
CONFIG_GPIO=y
```

## src/main.c
```c
#include <zephyr/kernel.h>
#include <zephyr/drivers/gpio.h>
#include <zephyr/sys/printk.h>

#define LED0_NODE DT_ALIAS(led1)

static const struct gpio_dt_spec led = GPIO_DT_SPEC_GET(LED0_NODE, gpios);

int main(void)
{
    int ret;

    // 1. Vérification Hardware
    if (!gpio_is_ready_dt(&led)) {
        return 0;
    }

    // 2. Configuration de la pin en sortie
    ret = gpio_pin_configure_dt(&led, GPIO_OUTPUT_ACTIVE);
    if (ret < 0) {
        return 0;
    }

    printk("Démarrage du test LED...\n");

    // 3. Boucle infinie
    while (1) {
        gpio_pin_toggle_dt(&led); // On inverse l'état (ON/OFF)
        printk("Blink !\n");      // Petit message dans le terminal pour être sûr
        k_msleep(1000);           // Pause de 1000ms (1 seconde)
    }
    return 0;
}
```
